#include "keypos/eyelash_corne.h"

#define ZMK_LAYER(LT, RT, LM, RM, LB, RB, LH, RH) \
    LT       &none       RT \
    LM &none &none &none RM \
    LB &none &none       RB \
    LH                   RH

#include "keymap.dtsi"
